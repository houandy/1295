## Kernel-Release/kernel-4.9/drivers/soc/realtek/common/dvfs/Kconfig
```kconfig
config RTK_CPU_CACHE_SUPPLY_COORDINATOR
	bool "Realtek CPU cache supply coordinator"
	depends on REGULATOR_G2227
	depends on ARCH_RTD129x
	default y

config RTK_CPU_SUPPLY_ENHANCER
	bool "Realtek CPU supply enhancer"
	depends on ARCH_RTD139x || ARCH_RTD16xx
	default y

config RTK_CPU_HIGH_LOAD_BOOSTER
	bool "Realtek CPU high-load booster"
	default n
```

## OpenWRT-LEDE/local/realtek/rtk-bluecore/Config.in
```kconfig
menuconfig RTK_ACPU_FW_FILE
	string
	prompt "Realtek ACPU FW filename"
	depends on PACKAGE_rtk-bluecore
	default "bluecore.audio.CVBS_On" if RTK_NAS_VIDEO && RTK_BOARD_CHIP_1295
	default "bluecore.audio" if RTK_NAS_VIDEO
	default "bluecore.audio.slim" if RTK_NAS_TRANSCODE
	default "bluecore.audio.slim_disable_vo" if RTK_BOARD_CHIP_1295
	default "bluecore.audio.slim"
	help
	  Specifies Realtek Audio CPU firmware filename
```

## OpenWRT/local/realtek/rtk-bluecore/Config.in
```kconfig
menuconfig UPDATE_AUDIO_FW
	bool "Update audio FW to dailybuild"
	default y
	depends on PACKAGE_rtk-bluecore && (RTK_BOARD_CHIP_1295 || TARGET_realtek_rtd129x || TARGET_realtek_rtd139x || TARGET_realtek_rtd16xx)
	help
	  Sync to latest dailybuild or keep at a specific tag.


	choice
		prompt "Audio fw address"
		default AUDIO_ADDR_NEW
		depends on UPDATE_AUDIO_FW
		help
		  Choose the audio fw address

		config AUDIO_ADDR_LEGACY
			bool "0x01b00000"
			depends on RTK_BOARD_CHIP_1295

		config AUDIO_ADDR_NEW
			bool "0x0F900000"
	endchoice
```

## OpenWRT/local/realtek/rtk-imagefile/Config.in
```kconfig
choice
	prompt "Realtek eMMC layout size"
	default RTK_IMG_LAYOUT_SIZE_4GB
	depends on RTK_BOARD_FWDESC_LAYOUT && PACKAGE_rtk-imagefile && PACKAGE_kmod-rtk-emmc
	help
	  Select the size of the target eMMC

	config RTK_IMG_LAYOUT_SIZE_4GB
		bool "4GB"

	config RTK_IMG_LAYOUT_SIZE_8GB
		bool "8GB"

	config RTK_IMG_LAYOUT_SIZE_16GB
		bool "16GB"

	config RTK_IMG_LAYOUT_SIZE_32GB
		bool "32GB"
endchoice

config TARGET_NAS_IMG_EMMC_SWAP
	bool "Enable eMMC swap"

config RTK_NAS_IMG_DUAL_BOOT
	bool "Dual boot"
	depends on RTK_BOARD_FWDESC_LAYOUT && PACKAGE_rtk-imagefile && PACKAGE_kmod-rtk-emmc

menuconfig RTK_NAS_IMG_CUSTOMIZE_FWSIZE
	bool "FW size customization"
	default y if RTK_NAS_IMG_DUAL_BOOT
	depends on RTK_BOARD_FWDESC_LAYOUT && PACKAGE_rtk-imagefile && PACKAGE_kmod-rtk-emmc
	help
	  Set customized size of minimum normal FWs.

	config KERNELDT_MINSIZE
		int
		prompt "Minimum size of kernel DTB (in KB)" if RTK_NAS_IMG_CUSTOMIZE_FWSIZE
		default 256
		depends on RTK_BOARD_FWDESC_LAYOUT && PACKAGE_rtk-imagefile && PACKAGE_kmod-rtk-emmc
		help
		  The size reserved on flash layout for kernel DTB

	config RESCUEDT_MINSIZE
		int
		prompt "Minimum size of rescue kernel DTB (in KB)" if RTK_NAS_IMG_CUSTOMIZE_FWSIZE
		default 256
		depends on RTK_BOARD_FWDESC_LAYOUT && PACKAGE_rtk-imagefile && PACKAGE_kmod-rtk-emmc
		help
		  The size reserved on flash layout for rescue kernel DTB

	config LINUX_MINSIZE
		int
		prompt "Minimum size of kernel image (in KB)" if RTK_NAS_IMG_CUSTOMIZE_FWSIZE
		default 13312
		depends on RTK_BOARD_FWDESC_LAYOUT && PACKAGE_rtk-imagefile && PACKAGE_kmod-rtk-emmc
		help
		  The size reserved on flash layout for Linux kernel image

	config RESCUEROOTFS_MINSIZE
		int
		prompt "Minimum size of rescue rootfs (in KB)" if RTK_NAS_IMG_CUSTOMIZE_FWSIZE
		default 4096
		depends on RTK_BOARD_FWDESC_LAYOUT && PACKAGE_rtk-imagefile && PACKAGE_kmod-rtk-emmc
		help
		  The size reserved on flash layout for rescue rootfs

	config AUDIO_MINSIZE
		int
		prompt "Minimum size of audio FW (in KB)" if RTK_NAS_IMG_CUSTOMIZE_FWSIZE
		default 4096
		depends on RTK_BOARD_FWDESC_LAYOUT && PACKAGE_rtk-imagefile && PACKAGE_kmod-rtk-emmc
		help
		  The size reserved on flash layout for audio FW

	config LOGO_MINSIZE
		int
		prompt "Minimum size of logo image (in KB)" if RTK_NAS_IMG_CUSTOMIZE_FWSIZE
		default 8192
		depends on RTK_BOARD_FWDESC_LAYOUT && PACKAGE_rtk-imagefile && PACKAGE_kmod-rtk-emmc
		help
		  The size reserved on flash layout for logo image
```

## OpenWRT/target/linux/realtek/Config.in
```kconfig
config RTK_BOARD_CHIP_1295
	bool
	depends on TARGET_realtek_rtd129x

config RTK_BOARD_CHIP_1296
	bool
	depends on TARGET_realtek_rtd129x

config RTK_BOARD_CHIP_1395
	bool
	depends on TARGET_realtek_rtd139x

config RTK_BOARD_CHIP_1619
	bool
	depends on TARGET_realtek_rtd16xx

config RTK_BOARD_CHIP
	string
	depends on TARGET_realtek
	default "rtd-1295" if RTK_BOARD_CHIP_1295
	default "rtd-1296" if RTK_BOARD_CHIP_1296
	default "rtd-1395" if RTK_BOARD_CHIP_1395
	default "rtd-1619" if TARGET_realtek_rtd16xx

config RTK_BOARD_CHIP_CODENAME
	string
	depends on TARGET_realtek
	default "rtd12xx" if TARGET_realtek_rtd129x
	default "rtd13xx" if TARGET_realtek_rtd139x
	default "rtd16xx" if TARGET_realtek_rtd16xx

choice
	prompt "DDR memory size on board"
	depends on TARGET_realtek
	default RTK_BOARD_DDR_2GB if TARGET_realtek_rtd129x
	default RTK_BOARD_DDR_1GB
	help
	  Select DDR memory size for Realtek boards.

	config RTK_BOARD_DDR_1GB
		bool "1GB"
		depends on !RTK_BOARD_CHIP_1619

	config RTK_BOARD_DDR_1.5GB
		bool "1.5GB"
		depends on RTK_BOARD_CHIP_1295 && !RTK_BOARD_CHIP_1395 && !RTK_BOARD_CHIP_1619

	config RTK_BOARD_DDR_2GB
		bool "2GB"

	config RTK_BOARD_DDR_3GB
		bool "3GB"
		depends on RTK_BOARD_CHIP_1296 && !RTK_BOARD_CHIP_1395 && !RTK_BOARD_CHIP_1619

	config RTK_BOARD_DDR_4GB
		bool "4GB"
		depends on RTK_BOARD_CHIP_1296 && !RTK_BOARD_CHIP_1395 && !RTK_BOARD_CHIP_1619
endchoice

config RTK_BOARD_DDR_SIZE
	string
	depends on TARGET_realtek
	default "1GB" if RTK_BOARD_DDR_1GB
	default "1.5GB" if RTK_BOARD_DDR_1.5GB
	default "2GB" if RTK_BOARD_DDR_2GB
	default "3GB" if RTK_BOARD_DDR_3GB
	default "4GB" if RTK_BOARD_DDR_4GB

source "Config-nas.in"
```

## OpenWRT/target/linux/realtek/image/Config.in
```kconfig
config RTK_BOARD_MTD_LAYOUT
	bool
	depends on TARGET_realtek
	default n

menuconfig RTK_BOARD_MTD_CUSTOMIZE_FWSIZE
	bool "Customized firmware size"
	depends on RTK_BOARD_MTD_LAYOUT
	help
	  Use static FW layout partition without fwdesc table.

	config RTK_MTD_ROOTFS_SIZE
		int "SPI 1st rootfs size (in KB)" if RTK_BOARD_MTD_CUSTOMIZE_FWSIZE
		depends on RTK_BOARD_MTD_LAYOUT
		default 2240
		help
		  Default size is 2240KB for 8MB SPI layout and could be increased
		  if either larger SPI NOR flash is used or layout is modified.
		  Need to enable overlay partition or modify initrd entry in DTS
		  on size over 4MB.

	config RTK_MTD_UBOOT_SIZE
		int "SPI uboot size (in KB)" if RTK_BOARD_MTD_CUSTOMIZE_FWSIZE
		depends on RTK_BOARD_MTD_LAYOUT
		default 512
		help
		  Default size is 512KB for 8MB SPI layout.

	config RTK_MTD_KERNEL_SIZE
		int "SPI kernel size (in KB)" if RTK_BOARD_MTD_CUSTOMIZE_FWSIZE
		depends on RTK_BOARD_MTD_LAYOUT
		default 3520
		help
		  Default size is 3520KB for 8MB SPI layout.

	config RTK_MTD_DTB_SIZE
		int "SPI kernel size (in KB)" if RTK_BOARD_MTD_CUSTOMIZE_FWSIZE
		depends on RTK_BOARD_MTD_LAYOUT
		default 64
		help
		  Default size is 64KB for 8MB SPI layout.

	config RTK_MTD_AFW_SIZE
		int "SPI audio FW size (in KB)" if RTK_BOARD_MTD_CUSTOMIZE_FWSIZE
		depends on RTK_BOARD_MTD_LAYOUT
		default 1408
		help
		  Default size is 1408KB for 8MB SPI layout.

	config RTK_MTD_LOGO_SIZE
		int "SPI boot image size (in KB)" if RTK_BOARD_MTD_CUSTOMIZE_FWSIZE
		depends on RTK_BOARD_MTD_LAYOUT
		default 320
		help
		  Default size is 320KB for 8MB SPI layout.

config RTK_BOARD_FWDESC_LAYOUT
	bool
	select PACKAGE_rtk-imagefile
	select PACKAGE_iperf
	select PACKAGE_iperf3
	depends on TARGET_realtek && !RTK_BOARD_MTD_LAYOUT
	default y
	help
	  Use Realtek FW layout partition with fwdesc table.
```
