
#include "rtd-1619-qa-rescue.dts"

/ {
	chosen {
		linux,initrd-start = <ROOTFS_RESCUE_START>;
		linux,initrd-end = <ROOTFS_RESCUE_END>;
		bootargs ="earlycon=uart8250,mmio32,0x98007800 console=ttyS0,115200 cma=8m@240m init=/init loglevel=8";
	};
};